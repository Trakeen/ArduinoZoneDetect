/**
 * BasicUsage.ino
 *
 * Demonstrates ArduinoZoneDetect on an ESP32 or Arduino with SD card.
 * Required files on SD card:
 *   /timezone21.bin  (or timezone16.bin)
 *   /dst_rules.bin   (generated by tools/generate_dst_bin.py)
 *
 * From https://github.com/BertoldVdb/ZoneDetect you can download the
 * pre-built timezone21.bin / timezone16.bin binary files.
 */

#include <Arduino.h>
#include <SD.h>
#include <SPI.h>
#include "ZoneDetect.h"
#include "DST.h"

// Adjust for your board
static const int SD_CS_PIN = 5;

// -- ZDFileReader wrappers ---------------------------------------------------
ZDFileReader<File> *zdReader  = nullptr;
ZDFileReader<File> *dstReader = nullptr;

ZoneDetect zd;
DST        dst;

File tzFile;
File dstFile;

// ---------------------------------------------------------------------------
void setup()
{
    Serial.begin(115200);
    delay(500);

    // Init SD card
    if (!SD.begin(SD_CS_PIN)) {
        Serial.println("SD init failed!");
        return;
    }

    // Open timezone binary (try 21-bit first, fall back to 16-bit)
    tzFile = SD.open("/timezone21.bin", FILE_READ);
    if (!tzFile) {
        tzFile = SD.open("/timezone16.bin", FILE_READ);
    }
    if (!tzFile) {
        Serial.println("Could not open timezone bin file!");
        return;
    }

    zdReader = new ZDFileReader<File>(tzFile);
    if (!zd.begin(zdReader)) {
        Serial.print("ZoneDetect init error: ");
        Serial.println(zd.lastError());
        return;
    }
    Serial.println("ZoneDetect ready.");

    // Open DST rules binary (optional – skip if not present)
    dstFile = SD.open("/dst_rules.bin", FILE_READ);
    if (dstFile) {
        dstReader = new ZDFileReader<File>(dstFile);
        if (!dst.begin(dstReader)) {
            Serial.print("DST init error: ");
            // not fatal
        } else {
            Serial.println("DST rules ready.");
        }
    } else {
        Serial.println("dst_rules.bin not found – DST will not be applied.");
    }

    // -----------------------------------------------------------------------
    // Example coordinates: Eiffel Tower, Paris
    float lat =  48.8584f;
    float lon =   2.2945f;

    char tzId[48];
    if (zd.getTimezoneId(lat, lon, tzId, sizeof(tzId))) {
        Serial.print("Timezone: ");
        Serial.println(tzId);

        // Example UTC Unix timestamp: 2024-03-31 01:00:00 UTC
        // (France switches to summer time on this date)
        uint32_t utcNow = 1711846800UL;

        if (dstFile) {
            int32_t offsetSec = 0;
            if (dst.getUtcOffset(tzId, utcNow, offsetSec)) {
                int h = (int)(offsetSec / 3600);
                int m = (int)(abs((int)(offsetSec % 3600)) / 60);
                Serial.print("UTC offset: ");
                if (h >= 0) Serial.print('+');
                Serial.print(h);
                Serial.print(':');
                if (m < 10) Serial.print('0');
                Serial.println(m);

                // toLocalTime returns uint32_t; pass directly to DateTime if using RTClib:
                //   #include <RTClib.h>
                //   DateTime localDt(dst.toLocalTime(tzId, utcNow));
                uint32_t localUnix = dst.toLocalTime(tzId, utcNow);
                uint32_t tod = localUnix % 86400UL;
                Serial.printf("Local time (HH:MM:SS): %02d:%02d:%02d\n",
                              (int)(tod / 3600), (int)((tod % 3600) / 60), (int)(tod % 60));
            } else {
                Serial.println("tzId not found in dst_rules.bin – run generate_dst_bin.py");
            }
        }
    } else {
        Serial.print("No timezone found (ocean?). Error: ");
        Serial.println(zd.lastError() ? zd.lastError() : "none");
    }

    // -----------------------------------------------------------------------
    // Example 2: Auckland, New Zealand (southern hemisphere DST)
    lat = -36.8509f; lon = 174.7645f;
    if (zd.getTimezoneId(lat, lon, tzId, sizeof(tzId))) {
        Serial.print("Auckland timezone: ");
        Serial.println(tzId);
    }
}

void loop() {}
